## esp32/main/Kconfig.projbuild
```kconfig
menu "INVO Wi-Fi"

    config ESP_WIFI_SSID
        string "Wi-Fi SSID"
        default "MySSID"
        help
            SSID of the access point to connect to.

    config ESP_WIFI_PASSWORD
        string "Wi-Fi Password"
        default "MyPassword"
        help
            Wi-Fi password.

endmenu

menu "Groq AI"

    config GROQ_API_KEY
        string "Groq API Key"
        default ""
        help
            API key for Groq Whisper STT, Llama LLM, and Orpheus TTS.
            Get a key at https://console.groq.com/keys

endmenu
```

## esp32/sdkconfig.defaults
```kconfig
CONFIG_IDF_EXPERIMENTAL_FEATURES=y
CONFIG_SPIRAM=y
CONFIG_SPIRAM_MODE_HEX=y
CONFIG_SPIRAM_SPEED_200M=y
CONFIG_SPIRAM_FETCH_INSTRUCTIONS=y
CONFIG_SPIRAM_RODATA=y
CONFIG_SPIRAM_XIP_FROM_PSRAM=y
CONFIG_SPIRAM_FLASH_LOAD_TO_PSRAM=y
CONFIG_SPIRAM_ALLOW_STACK_EXTERNAL_MEMORY=y
CONFIG_SPIRAM_BOOT_INIT=y
CONFIG_SPIRAM_USE_MALLOC=y
CONFIG_ESP_HOSTED_MEMPOOL_PREFER_SPIRAM=y
CONFIG_ESP_HOSTED_SDIO_CLOCK_FREQ_KHZ=20000
CONFIG_ESP_HOSTED_TRANSPORT_RESTART_ON_FAILURE=n
CONFIG_ESP_HOSTED_SDIO_TX_Q_SIZE=64
CONFIG_ESP_HOSTED_SDIO_RX_Q_SIZE=64
# TCP window = 1 MSS: server sends only ONE 1460-B segment before waiting for ACK.
# C6 finishes forwarding it over SDIO in ~0.6ms then sits idle — P4's write
# succeeds on first retry at 10ms.  With 4×MSS (5760) the server pipelines
# 4 segments, C6 stays in TX mode for ~2.4ms, P4 retries fail → blip cascade.
CONFIG_LWIP_TCP_WND_DEFAULT=1460
CONFIG_LWIP_TCP_SND_BUF_DEFAULT=8760
# TLS 1.3 early-data streams firmware before P4's Finished, saturating C6 SDIO TX.
# TLS 1.2 requires server to wait for client Finished before any app data.
CONFIG_MBEDTLS_SSL_PROTO_TLS1_3=n
# IN stays at 16384 (GitHub CDN sends large records). OUT at 4096 is fine
# since we only send small records (ACKs, HTTP GET).
CONFIG_MBEDTLS_SSL_IN_CONTENT_LEN=16384
CONFIG_MBEDTLS_SSL_OUT_CONTENT_LEN=4096
# Dynamic buffers cut peak TLS heap from ~50 KB to ~25 KB.
CONFIG_MBEDTLS_DYNAMIC_BUFFER=y
CONFIG_MBEDTLS_DYNAMIC_FREE_PEER_CERT=y
CONFIG_MBEDTLS_DYNAMIC_FREE_CONFIG_DATA=y
# Hardware AES/SHA need DMA-capable internal DRAM on every block — fails when
# heap is fragmented during OTA. Software fallback uses PSRAM instead.
CONFIG_MBEDTLS_HARDWARE_AES=n
CONFIG_MBEDTLS_HARDWARE_SHA=n
# Route mbedTLS malloc to default heap (PSRAM via SPIRAM_USE_MALLOC) — no DMA
# requirement with software crypto, so the 16 KB TLS RX buffer is trivial.
CONFIG_MBEDTLS_INTERNAL_MEM_ALLOC=n
CONFIG_MBEDTLS_DEFAULT_MEM_ALLOC=y
CONFIG_SLAVE_IDF_TARGET_ESP32C6=y
CONFIG_ESP_HOSTED_CP_TARGET_ESP32C6=y
CONFIG_ESP_HTTPS_OTA_ALLOW_HTTP=y
CONFIG_PARTITION_TABLE_CUSTOM=y
CONFIG_PARTITION_TABLE_CUSTOM_FILENAME="partitions.csv"
CONFIG_ESPTOOLPY_FLASHSIZE_8MB=y
CONFIG_ESPTOOLPY_FLASHSIZE="8MB"
CONFIG_LV_FONT_MONTSERRAT_12=y
CONFIG_LV_FONT_MONTSERRAT_14=y
CONFIG_LV_FONT_MONTSERRAT_16=y
CONFIG_LV_FONT_MONTSERRAT_20=y
CONFIG_LV_FONT_MONTSERRAT_24=y
CONFIG_LV_FONT_MONTSERRAT_36=y
CONFIG_LV_FONT_MONTSERRAT_48=y
CONFIG_ESP_TASK_WDT_TIMEOUT_S=30
CONFIG_LV_MEM_POOL_EXPAND_SIZE_KILOBYTES=512
CONFIG_FREERTOS_HZ=1000
CONFIG_ESP_MAIN_TASK_STACK_SIZE=10240
CONFIG_COMPILER_OPTIMIZATION_PERF=y
CONFIG_SPIRAM_XIP_FROM_PSRAM=y
CONFIG_CACHE_L2_CACHE_256KB=y
CONFIG_CACHE_L2_CACHE_LINE_128B=y
CONFIG_LV_OS_FREERTOS=y
CONFIG_LV_DRAW_SW_DRAW_UNIT_CNT=4
CONFIG_LV_ATTRIBUTE_FAST_MEM_USE_IRAM=y
CONFIG_LV_DEF_REFR_PERIOD=15
CONFIG_APP_PROJECT_VER="1.0.1"
CONFIG_BOOTLOADER_APP_ROLLBACK_ENABLE=y
CONFIG_USB_OTG_SUPPORTED=y
CONFIG_USB_HOST_CONTROL_TRANSFER_MAX_SIZE=256
CONFIG_ESP_CONSOLE_USB_SERIAL_JTAG=y
```

## src/Kconfig.projbuild
```kconfig
menu "INVO Wi-Fi"

    config ESP_WIFI_SSID
        string "Wi-Fi SSID"
        default ""
        help
            SSID of the access point to connect to.

    config ESP_WIFI_PASSWORD
        string "Wi-Fi Password"
        default ""
        help
            Wi-Fi password.

endmenu
```
